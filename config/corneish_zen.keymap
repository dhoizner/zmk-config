/* source keypos definitions */
#include "zmk-helpers/key-labels/36.h"

/* map Zen's extra keys */
#define X_LH  &smart_mouse  // thumb row, left
#define X_RH  &bs_del       // thumb row, right

/* activate bluetooth */
#define CONFIG_WIRELESS 1

/* source the main keymap */
#include "base.keymap"

/* use 5-column layout for Zen */
/ { chosen { zmk,matrix_transform = &five_column_transform; }; };

